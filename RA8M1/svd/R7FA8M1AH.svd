# R7FA8M1AH register map
Vendor: Renesas; Series: RA8; File version: 1.2
ARM 32-bit Olympus Microcontroller based device, CPU clock up to 480MHz, etc.
CPU: CM85 r0p0, little endian, MPU, FPU, VTOR, 4 interrupt priority bits
Registers are 32-bit, read-write, reset 0x0 unless marked. A register's access mark holds for its fields unless they carry their own. Offsets are from the block's base; lines under a group give offsets from that group; [hi:lo] are bit positions; {n}, {i} and the like mark numbered series; 'fields as' and 'values as' point back to an identical list; <NAME> marks a mode.

## Memory map
0x40000000 RMPU blocks up to offset 0xE28 — Renesas Memory Protection Unit
0x40002000 SRAM blocks up to offset 0x154 — SRAM Control
0x40003000 BUS blocks up to offset 0x1B2C — BUS Control
0x40004000 TZF blocks up to offset 0x16 — TrustZone Filter
0x40006000 ICU_COMMON blocks up to offset 0x70 — Common Interrupt Controller
0x40008000 CPSCU blocks up to offset 0xD01 — CPU System Security Control Unit
{0x4000A000+0x40*n} DMAC{n} blocks up to offset 0x31 (n=0..7) — Direct memory access controller {n}
0x4000A800 DMA blocks up to offset 0xA0 — DMAC Module Activation
0x4000AC00 DTC blocks up to offset 0x24 — Data Transfer Controller
0x4000C000 ICU blocks up to offset 0x480 — Interrupt Controller
0x40011000 CPU_OCD blocks up to offset 0x304 — On-Chip Debug
0x4001B000 CPU_DBG blocks up to offset 0x314 — Debug Function
0x4001C100 FCACHE blocks up to offset 0x42 — Flash Cache
0x4001E000 SYSC blocks up to offset 0xD80 — System Control
0x4011B17C TSD size 0x4 — Temperature Sensor Data
0x4011C000 FLAD blocks up to offset 0x41 — Data Flash
0x4011E000 FACI blocks up to offset 0x816 — Flash Application Command Interface
0x40201000 ELC blocks up to offset 0xF8 — Event Link Controller
0x40202000 RTC blocks up to offset 0x8C — Realtime Clock
0x40202200 IWDT blocks up to offset 0x9 — Independent Watchdog Timer
0x40202400 CAC blocks up to offset 0xD — Clock Frequency Accuracy Measurement Circuit
0x40202600 WDT blocks up to offset 0xD — Watchdog Timer
0x40203000 MSTP size 0x14 — Module Stop Control A,B,C,D,E
0x40204000 PSCU size 0x3C — Peripheral Security Control Unit
0x40212000 POEG size 0x400 — Port Output Enable Module for GPT
0x40220000 ULPT0 size 0x13 — Ultra-Low Power Timer 0
0x40220100 ULPT1 size 0x13 — Ultra-Low Power Timer 1
0x40221000 AGT0 blocks up to offset 0x10 — Low Power Asynchronous General purpose Timer 0
0x40221100 AGT1 blocks up to offset 0x10 — Low Power Asynchronous General purpose Timer 1
0x40235000 TSN size 0x4 — Temperature Sensor
0x40236000 ACMPHS0 blocks up to offset 0x45 — High-Speed Analog Comparator 0
0x40236100 ACMPHS1 blocks up to offset 0x45 — High-Speed Analog Comparator 1
0x40250000 USBFS blocks up to offset 0x518 — USB 2.0 FS Module
0x40252000 SDHI0 blocks up to offset 0x200 — SD Host Interface 0
0x40252400 SDHI1 blocks up to offset 0x200 — SD Host Interface 1
0x4025D000 SSIE0 blocks up to offset 0x28 — Serial Sound Interface Enhanced (SSIE)
0x4025D100 SSIE1 blocks up to offset 0x28 — Serial Sound Interface Enhanced (SSIE)
0x4025E000 IIC0 blocks up to offset 0x18 — Inter-Integrated Circuit 0
0x4025E014 IIC0WU blocks up to offset 0x4 — Inter-Integrated Circuit 0 Wake-up Unit
0x4025E100 IIC1 blocks up to offset 0x16 — Inter-Integrated Circuit 1
0x40268000 xSPI blocks up to offset 0x22C — eXpanded SPI
0x40310000 CRC blocks up to offset 0xE — CRC Calculator
0x40311000 DOC blocks up to offset 0x18 — Data Operation Circuit-4
{0x4030E000+0x100*n} GPT{n} blocks up to offset 0xD8 (n=320..327) — General PWM 32-bit Timer {n-320}
0x40322800 GPT168 blocks up to offset 0xD8 — General PWM 16-bit Timer 8
0x40322900 GPT169 blocks up to offset 0xD8 — General PWM 16-bit Timer 9
0x40322A00 GPT1610 blocks up to offset 0xD8 — General PWM 16-bit Timer 10
0x40322B00 GPT1611 blocks up to offset 0xD8 — General PWM 16-bit Timer 11
0x40322C00 GPT1612 blocks up to offset 0xD8 — General PWM 16-bit Timer 12
0x40322D00 GPT1613 blocks up to offset 0xD8 — General PWM 16-bit Timer 13
0x40323F00 GPT_OPS size 0x4 — Output Phase Switching Controller
0x40332000 ADC120 blocks up to offset 0x1E1 — 12bit A/D Converter 0
0x40332200 ADC121 blocks up to offset 0x1E1 — 12bit A/D Converter 1
0x40333000 DAC12 blocks up to offset 0x10C6 — 12-bit D/A converter
0x40342000 GLCDC blocks up to offset 0x1454 — Graphics LCD Controller
0x40344000 DRW blocks up to offset 0xEC — 2D Drawing Engine
0x40346000 DSILINK blocks up to offset 0x88F
0x40346C00 DPHYCNT blocks up to offset 0x144 — D-PHY Controller Top
0x40348000 CEU blocks up to offset 0x20A0 — Capture Engine Unit
0x40351000 USBHS blocks up to offset 0x16C — USB 2.0 High-Speed Module
0x40354000 EDMAC0 blocks up to offset 0xDC — DMA Controller for the Ethernet Controller Channel 0
0x40354100 ETHERC0 blocks up to offset 0x1874 — Ethernet Controller Channel 0
0x40358000 SCI0 blocks up to offset 0x7C — Serial Communication Interface 0
0x40358100 SCI1 blocks up to offset 0x7C — Serial Communication Interface 1
0x40358200 SCI2 blocks up to offset 0x7C — Serial Communication Interface 2
0x40358300 SCI3 blocks up to offset 0x7C — Serial Communication Interface 3
0x40358400 SCI4 blocks up to offset 0x7C — Serial Communication Interface 4
0x40358900 SCI9 blocks up to offset 0x7C — Serial Communication Interface 9
0x4035C000 SPI0 blocks up to offset 0x70 — Serial Peripheral Interface 0
0x4035C100 SPI1 blocks up to offset 0x70 — Serial Peripheral Interface 1
0x4035F000 I3C blocks up to offset 0x400 — I2C I3C unified IP
0x4036F200 ECCMB0 blocks up to offset 0x14 — Error correction circuit for MBRAM0
0x4036F300 ECCMB1 blocks up to offset 0x14 — Error correction circuit for MBRAM1
0x40380000 CANFD0 blocks up to offset 0x1A04 — CANFD Module 0
0x40382000 CANFD1 blocks up to offset 0x1A04 — CANFD Module 1
0x40400000 PORT0 blocks up to offset 0xC — Port 0 Control Registers
0x40400020 PORT1 blocks up to offset 0x10 — Port 1 Control Registers
0x40400040 PORT2 blocks up to offset 0x10 — Port 2 Control Registers
0x40400060 PORT3 blocks up to offset 0x10 — Port 3 Control Registers
0x40400080 PORT4 blocks up to offset 0x10 — Port 4 Control Registers
0x404000A0 PORT5 blocks up to offset 0xC — Port 5 Control Registers
0x404000C0 PORT6 blocks up to offset 0xC — Port 6 Control Registers
0x404000E0 PORT7 blocks up to offset 0xC — Port 7 Control Registers
0x40400100 PORT8 blocks up to offset 0xC — Port 8 Control Registers
0x40400120 PORT9 blocks up to offset 0xC — Port 9 Control Registers
0x40400140 PORTA blocks up to offset 0xC — Port A Control Registers
0x40400160 PORTB blocks up to offset 0xC — Port B Control Registers
0x40400180 PORTC blocks up to offset 0xC — Port C Control Registers
0x404001A0 PORTD blocks up to offset 0xC — Port D Control Registers
0x404001C0 PORTE blocks up to offset 0xC — Port E Control Registers
0x404001E0 PORTF blocks up to offset 0xC — Port F Control Registers
0x40400200 PORTG blocks up to offset 0xC — Port G Control Registers
0x40400800 PFS blocks up to offset 0x572 — Pmn Pin Function Control Register
0x50000000 RMPU_NS blocks up to offset 0xE28 — Renesas Memory Protection Unit as Non-secure
0x50002000 SRAM_NS blocks up to offset 0x154 — SRAM Control as Non-secure
0x50003000 BUS_NS blocks up to offset 0x1B2C — BUS Control as Non-secure
0x50004000 TZF_NS blocks up to offset 0x16 — TrustZone Filter as Non-secure
0x50006000 ICU_COMMON_NS blocks up to offset 0x70 — Common Interrupt Controller as Non-secure
0x50008000 CPSCU_NS blocks up to offset 0xD01 — CPU System Security Control Unit as Non-secure
{0x5000A000+0x40*n} DMAC{n}_NS blocks up to offset 0x31 (n=0..7) — Direct memory access controller {n} as Non-secure
0x5000A800 DMA_NS blocks up to offset 0xA0 — DMAC Module Activation as Non-secure
0x5000AC00 DTC_NS blocks up to offset 0x24 — Data Transfer Controller as Non-secure
0x5000C000 ICU_NS blocks up to offset 0x480 — Interrupt Controller as Non-secure
0x50011000 CPU_OCD_NS blocks up to offset 0x304 — On-Chip Debug as Non-secure
0x5001B000 CPU_DBG_NS blocks up to offset 0x314 — Debug Function as Non-secure
0x5001C100 FCACHE_NS blocks up to offset 0x42 — Flash Cache as Non-secure
0x5001E000 SYSC_NS blocks up to offset 0xD80 — System Control as Non-secure
0x5011B17C TSD_NS size 0x4 — Temperature Sensor Data as Non-secure
0x5011C000 FLAD_NS blocks up to offset 0x41 — Data Flash as Non-secure
0x5011E000 FACI_NS blocks up to offset 0x816 — Flash Application Command Interface as Non-secure
0x50201000 ELC_NS blocks up to offset 0xF8 — Event Link Controller as Non-secure
0x50202000 RTC_NS blocks up to offset 0x8C — Realtime Clock as Non-secure
0x50202200 IWDT_NS blocks up to offset 0x9 — Independent Watchdog Timer as Non-secure
0x50202400 CAC_NS blocks up to offset 0xD — Clock Frequency Accuracy Measurement Circuit as Non-secure
0x50202600 WDT_NS blocks up to offset 0xD — Watchdog Timer as Non-secure
0x50203000 MSTP_NS size 0x14 — Module Stop Control A,B,C,D,E as Non-secure
0x50204000 PSCU_NS size 0x3C — Peripheral Security Control Unit as Non-secure
0x50212000 POEG_NS size 0x400 — Port Output Enable Module for GPT as Non-secure
0x50220000 ULPT0_NS size 0x13 — Ultra-Low Power Timer 0 as Non-secure
0x50220100 ULPT1_NS size 0x13 — Ultra-Low Power Timer 1 as Non-secure
0x50221000 AGT0_NS blocks up to offset 0x10 — Low Power Asynchronous General purpose Timer 0 as Non-secure
0x50221100 AGT1_NS blocks up to offset 0x10 — Low Power Asynchronous General purpose Timer 1 as Non-secure
0x50235000 TSN_NS size 0x4 — Temperature Sensor as Non-secure
0x50236000 ACMPHS0_NS blocks up to offset 0x45 — High-Speed Analog Comparator 0 as Non-secure
0x50236100 ACMPHS1_NS blocks up to offset 0x45 — High-Speed Analog Comparator 1 as Non-secure
0x50250000 USBFS_NS blocks up to offset 0x518 — USB 2.0 FS Module as Non-secure
0x50252000 SDHI0_NS blocks up to offset 0x200 — SD Host Interface 0 as Non-secure
0x50252400 SDHI1_NS blocks up to offset 0x200 — SD Host Interface 1 as Non-secure
0x5025D000 SSIE0_NS blocks up to offset 0x28 — Serial Sound Interface Enhanced (SSIE) as Non-secure
0x5025D100 SSIE1_NS blocks up to offset 0x28 — Serial Sound Interface Enhanced (SSIE) as Non-secure
0x5025E000 IIC0_NS blocks up to offset 0x18 — Inter-Integrated Circuit 0 as Non-secure
0x5025E014 IIC0WU_NS blocks up to offset 0x4 — Inter-Integrated Circuit 0 Wake-up Unit as Non-secure
0x5025E100 IIC1_NS blocks up to offset 0x16 — Inter-Integrated Circuit 1 as Non-secure
0x50268000 xSPI_NS blocks up to offset 0x22C — eXpanded SPI as Non-secure
0x50310000 CRC_NS blocks up to offset 0xE — CRC Calculator as Non-secure
0x50311000 DOC_NS blocks up to offset 0x18 — Data Operation Circuit-4 as Non-secure
{0x5030E000+0x100*n} GPT{n}_NS blocks up to offset 0xD8 (n=320..327) — General PWM 32-bit Timer {n-320} as Non-secure
0x50322800 GPT168_NS blocks up to offset 0xD8 — General PWM 16-bit Timer 8 as Non-secure
0x50322900 GPT169_NS blocks up to offset 0xD8 — General PWM 16-bit Timer 9 as Non-secure
0x50322A00 GPT1610_NS blocks up to offset 0xD8 — General PWM 16-bit Timer 10 as Non-secure
0x50322B00 GPT1611_NS blocks up to offset 0xD8 — General PWM 16-bit Timer 11 as Non-secure
0x50322C00 GPT1612_NS blocks up to offset 0xD8 — General PWM 16-bit Timer 12 as Non-secure
0x50322D00 GPT1613_NS blocks up to offset 0xD8 — General PWM 16-bit Timer 13 as Non-secure
0x50323F00 GPT_OPS_NS size 0x4 — Output Phase Switching Controller as Non-secure
0x50332000 ADC120_NS blocks up to offset 0x1E1 — 12bit A/D Converter 0 as Non-secure
0x50332200 ADC121_NS blocks up to offset 0x1E1 — 12bit A/D Converter 1 as Non-secure
0x50333000 DAC12_NS blocks up to offset 0x10C6 — 12-bit D/A converter as Non-secure
0x50342000 GLCDC_NS blocks up to offset 0x1454 — Graphics LCD Controller as Non-secure
0x50344000 DRW_NS blocks up to offset 0xEC — 2D Drawing Engine as Non-secure
0x50346000 DSILINK_NS blocks up to offset 0x88F — DSI Link as Non-secure
0x50346C00 DPHYCNT_NS blocks up to offset 0x144 — D-PHY Controller Top as Non-secure
0x50348000 CEU_NS blocks up to offset 0x20A0 — Capture Engine Unit as Non-secure
0x50351000 USBHS_NS blocks up to offset 0x16C — USB 2.0 High-Speed Module as Non-secure
0x50354000 EDMAC0_NS blocks up to offset 0xDC — DMA Controller for the Ethernet Controller Channel 0 as Non-secure
0x50354100 ETHERC0_NS blocks up to offset 0x1874 — Ethernet Controller Channel 0 as Non-secure
0x50358000 SCI0_NS blocks up to offset 0x7C — Serial Communication Interface 0 as Non-secure
0x50358100 SCI1_NS blocks up to offset 0x7C — Serial Communication Interface 1 as Non-secure
0x50358200 SCI2_NS blocks up to offset 0x7C — Serial Communication Interface 2 as Non-secure
0x50358300 SCI3_NS blocks up to offset 0x7C — Serial Communication Interface 3 as Non-secure
0x50358400 SCI4_NS blocks up to offset 0x7C — Serial Communication Interface 4 as Non-secure
0x50358900 SCI9_NS blocks up to offset 0x7C — Serial Communication Interface 9 as Non-secure
0x5035C000 SPI0_NS blocks up to offset 0x70 — Serial Peripheral Interface 0 as Non-secure
0x5035C100 SPI1_NS blocks up to offset 0x70 — Serial Peripheral Interface 1 as Non-secure
0x5035F000 I3C_NS blocks up to offset 0x400 — I2C I3C unified IP as Non-secure
0x5036F200 ECCMB0_NS blocks up to offset 0x14 — Error correction circuit for MBRAM0 as Non-secure
0x5036F300 ECCMB1_NS blocks up to offset 0x14 — Error correction circuit for MBRAM1 as Non-secure
0x50380000 CANFD0_NS blocks up to offset 0x1A04 — CANFD Module 0 as Non-secure
0x50382000 CANFD1_NS blocks up to offset 0x1A04 — CANFD Module 1 as Non-secure
0x50400000 PORT0_NS blocks up to offset 0xC — Port 0 Control Registers as Non-secure
0x50400020 PORT1_NS blocks up to offset 0x10 — Port 1 Control Registers as Non-secure
0x50400040 PORT2_NS blocks up to offset 0x10 — Port 2 Control Registers as Non-secure
0x50400060 PORT3_NS blocks up to offset 0x10 — Port 3 Control Registers as Non-secure
0x50400080 PORT4_NS blocks up to offset 0x10 — Port 4 Control Registers as Non-secure
0x504000A0 PORT5_NS blocks up to offset 0xC — Port 5 Control Registers as Non-secure
0x504000C0 PORT6_NS blocks up to offset 0xC — Port 6 Control Registers as Non-secure
0x504000E0 PORT7_NS blocks up to offset 0xC — Port 7 Control Registers as Non-secure
0x50400100 PORT8_NS blocks up to offset 0xC — Port 8 Control Registers as Non-secure
0x50400120 PORT9_NS blocks up to offset 0xC — Port 9 Control Registers as Non-secure
0x50400140 PORTA_NS blocks up to offset 0xC — Port A Control Registers as Non-secure
0x50400160 PORTB_NS blocks up to offset 0xC — Port B Control Registers as Non-secure
0x50400180 PORTC_NS blocks up to offset 0xC — Port C Control Registers as Non-secure
0x504001A0 PORTD_NS blocks up to offset 0xC — Port D Control Registers as Non-secure
0x504001C0 PORTE_NS blocks up to offset 0xC — Port E Control Registers as Non-secure
0x504001E0 PORTF_NS blocks up to offset 0xC — Port F Control Registers as Non-secure
0x50400200 PORTG_NS blocks up to offset 0xC — Port G Control Registers as Non-secure
0x50400800 PFS_NS blocks up to offset 0x572 — Pmn Pin Function Control Register as Non-secure

## Interrupts
{n} IEL{n} (ICU) (n=0..95) — ICU Interrupt {n}
